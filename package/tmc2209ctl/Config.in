## package/tmc2209ctl/Config.in
```kconfig
config BR2_PACKAGE_TMC2209CTL
	bool "tmc2209ctl"
	help
	  Command line tool to drive stepper motors through Trinamic
	  TMC2209 drivers sharing one UART: configuration and velocity
	  mode over the single-wire UART (PDN_UART), exact and
	  synchronised moves over STEP/DIR GPIOs.
```
